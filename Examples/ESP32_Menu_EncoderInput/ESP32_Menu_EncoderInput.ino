/*

  example in how to implement the menu library for and ESP32 and Adafruit libraries. This is an example that
  uses both menu types
  1) a simple selection menu (ItemMenu) where the user can scroll up/down and select
  an item and some action be performed such as drawing a screen or activating a sub menu
  2) an menu with in-line where the user can scroll up/down the list and select an item
  however the difference is that move/up down on a selected item will scroll the values of that
  menu item and NOT scroll the list, selecing a selected item will restor control to moving up/down
  3) a EditMenu menu with in-line an no icons (down and dirty)

  highlights
  1. menu items exceeds screen size but library handles wrapping
  2. each item selection has a range, increment and decimal readout
  3. items can also be read from a char array


  ESP32     display
  3v3         VCC
  GND         GND
  5           TFT_CS
  25          TFT_RESET
  2           TFT_DC
  23          MOSI
  18          SCK
  3v3         LED
  19          MISO
  3v3         BL
  
  ESP32         Encoder
  32            select button 1
  GND           select button 2
  27            encoder direction 1
  33            encoder direction 2
  GND           encoder dir ground
  
*/

// required libraries
#include "Adafruit_GFX.h"
#include "Adafruit_ST7735.h"
#include "Adafruit_ST7735_Menu.h"

// found in \Arduino\libraries\Adafruit-GFX-Library-master
#include "fonts\FreeSans9pt7b.h"
#include "fonts\FreeSans12pt7b.h"
#include "fonts\FreeSans18pt7b.h"
#include "fonts\FreeSansBold9pt7b.h"
#include "fonts\FreeSansBold12pt7b.h"

#include <ESP32Encoder.h>  // https://github.com/madhephaestus/ESP32Encoder

#define DATA_COLUMN 85

// esp32 pinouts
#define TFT_DC 2
#define TFT_CS 5
#define TFT_RST 25
#define LED_PIN 4

#define EN1_PIN 32
#define EN2_PIN 33
#define SE_PIN 34

// easy way to include fonts but change globally
#define FONT_SMALL FreeSans9pt7b      // font for menus
#define FONT_EDITTITLE FreeSans9pt7b  // font for menus
#define FONT_ITEM FreeSans9pt7b       // font for menus
#define FONT_TITLE FreeSans9pt7b      // font for all headings

#define DEBOUNCE 150

int MenuOption = 0;
int AllowColorMenu = 0;

// must have variables for each menu item
// best to have these global so you can use them in processing functions
int MenuOption1 = 0, MenuOption2 = 0, MenuOption3 = 0, MenuOption4 = 0;

int ColorOption1 = 0, ColorOption2 = 0, ColorOption3 = 0, ColorOption4 = 0, ColorOption5 = 0;
int ColorOption6 = 0, ColorOption7 = 0, ColorOption8 = 0, ColorOption9 = 0, ColorOption10 = 0, ColorOption11 = 0;

int OptionOption1 = 0, OptionOption2 = 0, OptionOption3 = 0, OptionOption4 = 0, OptionOption5 = 0;
int OptionOption6 = 0;

int WirelessOption1 = 0, WirelessOption2 = 0, WirelessOption3 = 0, WirelessOption4 = 0, WirelessOption5 = 0;
int WirelessOption6 = 0, WirelessOption7 = 0;

// variables to store some of the options, you will probably want a var for each
// note the menu code ONLY supports floats
// if you want to edit an int in the menu, still pass in a float and set decimal readout to 0
// the recast the float to an int upon menu comletion processing
float Temp1Adj = 0.2, Temp2Adj = -.3, AlarmVal = 1;

// encoder stuff
long Position = 0, oldPosition = 0;

// create some selectable menu sub-items, these are lists inside a menu item
const char *ReadoutItems[] = { "Absolute", "Deg F", "Deg C" };
const char *RefreshItems[] = { "Off", "1 second", "2 seconds", "10 seconds",
                               "30 seconds", "1 minute", "5 minutes" };
const char *PrecisionItems[] = { "10", "0", "0.0", "0.00", "0.000" };
const char *TuneItems[] = { "Slope/Offset", "Simple", "Linear", "2nd order ", "3rd order", "Log" };
const char *OffOnItems[] = { "Off", "On" };

const char *DataRateItems[] = { "300 baud", "1.2 kbd", "2.4 kbd", "4.8 kbd", "9.6 kbd", "19.2 kbd", "56 kbd" };

// OK i'm going crazy with examples, but this will help show more processing when an int is needed but a float returned
// from the menu code
const char *C_NAMES[] = { "White", "Black", "Grey", "Blue", "Red", "Green", "Cyan", "Magenta",
                          "Yellow", "Teal", "Orange", "Pink", "Purple", "Lt Grey", "Lt Blue", "Lt Red",
                          "Lt Green", "Lt Cyan", "Lt Magenta", "Lt Yellow", "Lt Teal", "Lt Orange", "Lt Pink", "Lt Purple",
                          "Medium Grey", "Medium Blue", "Medium Red", "Medium Green", "Medium Cyan", "Medium Magenta", "Medium Yellow", "Medium Teal",
                          "Medium Orange", "Medium Pink", "Medium Purple", "Dk Grey", "Dk Blue", "Dk Red", "Dk Green", "Dk Cyan",
                          "Dk Magenta", "Dk Yellow", "Dk Teal", "Dk Orange", "Dk Pink", "Dk Purple" };

const uint16_t C_VALUES[] = {
  0XFFFF, 0X0000, 0XC618, 0X001F, 0XF800, 0X07E0, 0X07FF, 0XF81F,  //7
  0XFFE0, 0X0438, 0XFD20, 0XF81F, 0X801F, 0XE71C, 0X73DF, 0XFBAE,  //15
  0X7FEE, 0X77BF, 0XFBB7, 0XF7EE, 0X77FE, 0XFDEE, 0XFBBA, 0XD3BF,  //23
  0X7BCF, 0X1016, 0XB000, 0X0584, 0X04B6, 0XB010, 0XAD80, 0X0594,  //31
  0XB340, 0XB00E, 0X8816, 0X4A49, 0X0812, 0X9000, 0X04A3, 0X0372,  //39
  0X900B, 0X94A0, 0X0452, 0X92E0, 0X9009, 0X8012                   //45
};
// set default colors
uint16_t MENU_TEXT = C_VALUES[1];
uint16_t MENU_BACKGROUND = C_VALUES[0];
uint16_t MENU_HIGHLIGHTTEXT = C_VALUES[1];
uint16_t MENU_HIGHLIGHT = C_VALUES[21];
uint16_t MENU_HIGHBORDER = C_VALUES[10];
uint16_t MENU_SELECTTEXT = C_VALUES[0];
uint16_t MENU_SELECT = C_VALUES[4];
uint16_t MENU_SELECTBORDER = C_VALUES[37];
uint16_t MENU_DISABLE = C_VALUES[2];
uint16_t TITLE_TEXT = C_VALUES[13];
uint16_t TITLE_BACK = C_VALUES[36];

// this next rediciously long section is merely the icon image data
// scroll down to 1560 or so for the actual code

// Website for generating icons
// https://javl.github.io/image2cpp/

// 'Alarm', 32x32px
const uint16_t epd_bitmap_Alarm[] PROGMEM = {
  0xffff, 0xffff, 0xffff, 0xffff, 0xffff, 0xffff, 0xffff, 0xffff, 0xffff, 0xffff, 0xffff, 0xffff, 0xffff, 0xffff, 0xffff, 0xffff,
  0xffff, 0xffff, 0xffff, 0xffff, 0xffff, 0xffff, 0xffff, 0xffff, 0xffff, 0xffff, 0xffff, 0xffff, 0xffff, 0xffff, 0xffff, 0xffff,
  0xffff, 0xffff, 0xffff, 0xffff, 0xffff, 0xffff, 0xffff, 0xffff, 0xffff, 0xffff, 0xffff, 0xffff, 0xffff, 0xffff, 0xffff, 0xffff,
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  0xef5d, 0xef7d, 0xffdf, 0xffff, 0xffff, 0xffff, 0xffff, 0xffff, 0xffff, 0xffff, 0xffff, 0xffff, 0xffff, 0xffff, 0xffff, 0xffff
};
// 'Precision', 32x32px
const uint16_t epd_bitmap_Precision[] PROGMEM = {
  0xffff, 0xffff, 0xffff, 0xffff, 0xffff, 0xffff, 0xffff, 0xffff, 0xffff, 0xffff, 0xffff, 0xffff, 0xffff, 0xffff, 0xffff, 0xffff,
  0xffff, 0xffff, 0xffff, 0xffff, 0xffff, 0xffff, 0xffff, 0xffff, 0xffff, 0xffff, 0xffff, 0xffff, 0xffff, 0xffff, 0xffff, 0xffff,
  0xffff, 0xffff, 0xffff, 0xffff, 0xffff, 0xffff, 0xffff, 0xffff, 0xffff, 0xffff, 0xffff, 0xffff, 0xffff, 0xffff, 0xffff, 0xffff,
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  0xffff, 0xffff, 0xffff, 0xffff, 0xffff, 0xffff, 0xffff, 0xffff, 0xffff, 0xffff, 0xffff, 0xffff, 0xffff, 0xffff, 0xffff, 0xffff
};
// 'readout', 32x32px
const uint16_t epd_bitmap_readout[] PROGMEM = {
  0xffdf, 0xbdf7, 0xa514, 0xa514, 0x9cf3, 0x9cf3, 0x9cf3, 0x9cf3, 0x9cf3, 0x9cf3, 0x9cf3, 0x9cf3, 0x9cf3, 0x9cf3, 0x9cf3, 0x9cf3,
  0x9cf3, 0x9cf3, 0x9cf3, 0x9cf3, 0x9cf3, 0x9cf3, 0x9cf3, 0x9cf3, 0x9cf3, 0x9cf3, 0x9cf3, 0x9cf3, 0xa514, 0xa514, 0xbdf7, 0xffdf,
  0xf79e, 0xa514, 0xffff, 0xffff, 0xffff, 0xffff, 0xffff, 0xffff, 0xffff, 0xffff, 0xffff, 0xffff, 0xffff, 0xffff, 0xffff, 0xffff,
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  0xef5d, 0xef5d, 0xef5d, 0xef5d, 0xef5d, 0xef5d, 0xef5d, 0xef5d, 0xef5d, 0xef5d, 0xef5d, 0xef5d, 0xef5d, 0xef5d, 0xef7d, 0xffdf
};
// 'Temp1', 32x32px
const uint16_t epd_bitmap_Temp1[] PROGMEM = {
  0xffff, 0xffff, 0xffff, 0xffff, 0xffff, 0xffff, 0xffff, 0xffff, 0xffff, 0xffff, 0xffff, 0xffff, 0xffff, 0xffff, 0xffff, 0xffff,
  0xffff, 0xffff, 0xffff, 0xffff, 0xffff, 0xffff, 0xffff, 0xffff, 0xffff, 0xffff, 0xffff, 0xffff, 0xffff, 0xffff, 0xffff, 0xffff,
  0xffff, 0xffff, 0xffff, 0xffff, 0xffff, 0xffff, 0xffff, 0xffff, 0xffff, 0xffff, 0xffff, 0xffff, 0xffff, 0xffff, 0xffff, 0xffff,
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  0xffff, 0xffff, 0xffff, 0xffff, 0xffff, 0xffff, 0xffff, 0xffff, 0xffff, 0xffff, 0xffff, 0xffff, 0xffff, 0xffff, 0xffff, 0xffff
};
// 'Temp2', 32x32px
const uint16_t epd_bitmap_Temp2[] PROGMEM = {
  0xffff, 0xffff, 0xffff, 0xffff, 0xffff, 0xffff, 0xffff, 0xffff, 0xffff, 0xffff, 0xffff, 0xffff, 0xffff, 0xffff, 0xffff, 0xffff,
  0xffff, 0xffff, 0xffff, 0xffff, 0xffff, 0xffff, 0xffff, 0xffff, 0xffff, 0xffff, 0xffff, 0xffff, 0xffff, 0xffff, 0xffff, 0xffff,
  0xffff, 0xffff, 0xffff, 0xffff, 0xffff, 0xffff, 0xffff, 0xffff, 0xffff, 0xffff, 0xffff, 0xffff, 0xffff, 0xffff, 0xffff, 0xffff,
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  0xffff, 0xffff, 0xffff, 0xffff, 0xffff, 0xffff, 0xffff, 0xffff, 0xffff, 0xffff, 0xffff, 0xffff, 0xffff, 0xffff, 0xffff, 0xffff
};
// 'Tune', 32x32px
const uint16_t epd_bitmap_Tune[] PROGMEM = {
  0xffff, 0xffff, 0xffff, 0xffff, 0xffff, 0xffff, 0xffff, 0xffff, 0xffff, 0xffff, 0xffff, 0xffff, 0xffff, 0xffff, 0xffff, 0xffff,
  0xffff, 0xffff, 0xffff, 0xffff, 0xffff, 0xffff, 0xffff, 0xffff, 0xffff, 0xffff, 0xffff, 0xffff, 0xffff, 0xffff, 0xffff, 0xffff,
  0xffff, 0xffff, 0xffff, 0xffff, 0xffff, 0xffff, 0xffff, 0xffff, 0xffff, 0xffff, 0xffbe, 0xee34, 0xe4ca, 0xdc05, 0xdc05, 0xdc25,
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  0xffff, 0xffff, 0xffff, 0xffff, 0xf79e, 0xd6ba, 0xc618, 0xbdf7, 0xce79, 0xef7d, 0xffff, 0xffff, 0xffff, 0xffff, 0xffff, 0xffff
};
// 'Update', 32x32px
const uint16_t epd_bitmap_Update[] PROGMEM = {
  0xffff, 0xffff, 0xffff, 0xffff, 0xffff, 0xffff, 0xffff, 0xffff, 0xffff, 0xffff, 0xffff, 0xffff, 0xffff, 0xffff, 0xffff, 0xffff,
  0xffff, 0xffff, 0xffff, 0xffff, 0xffff, 0xffff, 0xffff, 0xffff, 0xffff, 0xffff, 0xffff, 0xffff, 0xffff, 0xffff, 0xffff, 0xffff,
  0xffff, 0xffff, 0xffff, 0xffff, 0xffff, 0xffff, 0xffff, 0xffff, 0xffff, 0xffff, 0xffff, 0xbe9c, 0x64d8, 0x33f7, 0x1355, 0x1355,
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  0xef5d, 0xef5d, 0xef5d, 0xef7d, 0xf79e, 0xffdf, 0xffff, 0xffff, 0xffff, 0xffff, 0xffff, 0xffff, 0xffff, 0xffff, 0xffff, 0xffff
};


// 'b_alarm', 32x32px
const unsigned char epd_bitmap_b_alarm[] PROGMEM = {
  0x00, 0x01, 0x80, 0x00, 0x00, 0x03, 0xc0, 0x00, 0x00, 0x07, 0xe0, 0x00, 0x00, 0x0f, 0xf0, 0x00,
  0x00, 0x0e, 0x70, 0x00, 0x00, 0x1c, 0x38, 0x00, 0x00, 0x1c, 0x38, 0x00, 0x00, 0x38, 0x1c, 0x00,
  0x00, 0x31, 0x8c, 0x00, 0x00, 0x73, 0xce, 0x00, 0x00, 0xe3, 0xc7, 0x00, 0x00, 0xe3, 0xc7, 0x00,
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  0x00, 0x00, 0x00, 0x00, 0x00, 0x00, 0x00, 0x00, 0x00, 0x00, 0x00, 0x00, 0x00, 0x00, 0x00, 0x00
};
// 'b_motion', 64x64px
const unsigned char epd_bitmap_b_motion[] PROGMEM = {
  0x00, 0x00, 0x06, 0x06, 0x00, 0x00, 0x00, 0x00, 0x00, 0x00, 0x07, 0x0e, 0x00, 0x00, 0x00, 0x00,
  0x00, 0x08, 0x07, 0x87, 0x00, 0x00, 0x00, 0x00, 0x00, 0x7f, 0x83, 0x87, 0x00, 0x00, 0x00, 0x00,
  0x00, 0xff, 0xc1, 0xc3, 0x80, 0x00, 0x00, 0x00, 0x01, 0xe3, 0xe1, 0xc3, 0x80, 0x00, 0x00, 0x00,
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  0x00, 0x00, 0x01, 0xc3, 0x80, 0x00, 0x00, 0x00, 0x00, 0x00, 0x01, 0x83, 0x00, 0x00, 0x00, 0x00
};

// 'b_precision', 32x32px
const unsigned char epd_bitmap_b_precision[] PROGMEM = {
  0x00, 0xff, 0xf0, 0x00, 0x07, 0xe0, 0x7e, 0x00, 0x1c, 0x00, 0x03, 0x80, 0x30, 0x07, 0xc0, 0xc0,
  0x60, 0x7f, 0xc0, 0x20, 0xc0, 0xc0, 0x40, 0x20, 0x81, 0x80, 0x40, 0x30, 0x81, 0x80, 0x40, 0x70,
  0xc1, 0xf0, 0x43, 0xf0, 0xc1, 0x1f, 0xff, 0x30, 0xe1, 0x00, 0x00, 0x33, 0xb9, 0x00, 0x00, 0x3f,
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  0x06, 0x30, 0x60, 0xc1, 0x03, 0xb0, 0x60, 0xcf, 0x00, 0xf8, 0x67, 0xfc, 0x00, 0x1f, 0xff, 0x80
};
// 'b_reading', 32x32px
const unsigned char epd_bitmap_b_reading[] PROGMEM = {
  0x7f, 0xff, 0xff, 0xf0, 0xc0, 0x00, 0x00, 0x10, 0x80, 0x00, 0x00, 0x10, 0x80, 0x00, 0x00, 0x10,
  0xff, 0xff, 0xff, 0xf0, 0xff, 0xff, 0xff, 0xf0, 0x80, 0x00, 0x00, 0x10, 0x80, 0x00, 0x00, 0x10,
  0x80, 0x00, 0x00, 0x10, 0x80, 0x00, 0x00, 0x10, 0x8e, 0x7f, 0xff, 0x10, 0x80, 0x00, 0x00, 0x10,
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  0x00, 0x00, 0xcc, 0xcc, 0x00, 0x00, 0x67, 0x98, 0x00, 0x00, 0x3c, 0xf0, 0x00, 0x00, 0x0f, 0xc0
};
// 'b_refresh', 32x32px
const unsigned char epd_bitmap_b_refresh[] PROGMEM = {
  0x00, 0x0f, 0xf0, 0x00, 0x00, 0x7c, 0x3e, 0x00, 0x01, 0xc0, 0x03, 0x80, 0x03, 0x00, 0x00, 0xc0,
  0x06, 0x00, 0x00, 0x60, 0x0c, 0x00, 0x00, 0x30, 0x18, 0x07, 0xe0, 0x18, 0x30, 0x1c, 0x38, 0x0c,
  0x20, 0x70, 0x0e, 0x04, 0x60, 0xc0, 0x03, 0x06, 0x40, 0x80, 0x00, 0x02, 0x41, 0x80, 0x00, 0x02,
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  0x03, 0x00, 0x00, 0xc0, 0x01, 0xc0, 0x03, 0x80, 0x00, 0x7c, 0x3e, 0x00, 0x00, 0x0f, 0xf0, 0x00
};
// 'b_Option', 64x64px
const unsigned char epd_bitmap_b_Option[] PROGMEM = {
  0x00, 0x0f, 0xff, 0xff, 0xff, 0xff, 0xff, 0xfc, 0x00, 0x1f, 0xff, 0xff, 0xff, 0xff, 0xff, 0xfe,
  0x00, 0x3f, 0xff, 0xff, 0xff, 0xff, 0xff, 0xff, 0x00, 0x78, 0x00, 0x00, 0x00, 0x00, 0x00, 0x07,
  0x00, 0xf0, 0x00, 0x00, 0x00, 0x00, 0x00, 0x07, 0x01, 0xe3, 0xff, 0xff, 0xff, 0xff, 0xff, 0xe7,
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  0x7f, 0xff, 0xff, 0xff, 0xff, 0xff, 0xff, 0xfe, 0x3f, 0xff, 0xff, 0xff, 0xff, 0xff, 0xff, 0xfc
};
// 'b_temp1', 32x32px
const unsigned char epd_bitmap_b_temp1[] PROGMEM = {
  0x00, 0x03, 0xc0, 0x00, 0x00, 0x0e, 0x70, 0x00, 0x00, 0x08, 0x10, 0x00, 0x00, 0x18, 0x18, 0x00,
  0x00, 0x10, 0x08, 0xff, 0x00, 0x10, 0x0b, 0x80, 0x00, 0x10, 0x0e, 0x00, 0x00, 0x10, 0x18, 0x00,
  0x00, 0x10, 0x70, 0x00, 0x00, 0x11, 0xc8, 0x00, 0x00, 0x13, 0x18, 0x00, 0x00, 0x1e, 0x18, 0x00,
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  0x00, 0x60, 0x06, 0x00, 0x00, 0x30, 0x1c, 0x00, 0x00, 0x1f, 0x38, 0x00, 0x00, 0x07, 0xe0, 0x00
};
// 'b_temp2', 32x32px
const unsigned char epd_bitmap_b_temp2[] PROGMEM = {
  0x00, 0x03, 0xc0, 0x00, 0x00, 0x0e, 0x70, 0x00, 0x00, 0x08, 0x10, 0x00, 0x00, 0x18, 0x18, 0x00,
  0x00, 0x10, 0x08, 0xff, 0x00, 0x10, 0x0b, 0x80, 0x00, 0x10, 0x0e, 0x00, 0x00, 0x10, 0x18, 0x00,
  0x00, 0x10, 0x70, 0x00, 0x00, 0x11, 0xc8, 0x00, 0x00, 0x13, 0x18, 0x00, 0x00, 0x1e, 0x18, 0x00,
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  0x00, 0x60, 0x06, 0x00, 0x00, 0x30, 0x0c, 0x00, 0x00, 0x1f, 0x38, 0x00, 0x00, 0x07, 0xe0, 0x00
};
// 'b_tune', 32x32px
const unsigned char epd_bitmap_b_tune[] PROGMEM = {
  0x00, 0x00, 0x03, 0xc0, 0x00, 0x00, 0x0e, 0xe0, 0x00, 0x00, 0x18, 0x60, 0x00, 0x00, 0x20, 0xc0,
  0x00, 0x00, 0x21, 0x80, 0x00, 0x00, 0x61, 0x06, 0x00, 0x00, 0x62, 0x0f, 0x00, 0x00, 0x62, 0x1b,
  0x00, 0x00, 0x61, 0x31, 0x00, 0x00, 0x20, 0xe3, 0x00, 0x00, 0x20, 0x02, 0x00, 0x00, 0x40, 0x02,
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  0x03, 0x04, 0x00, 0x00, 0x06, 0x08, 0x00, 0x00, 0x07, 0x70, 0x00, 0x00, 0x03, 0xc0, 0x00, 0x00
};
// 'b_wireless', 64x64px
const unsigned char epd_bitmap_b_wireless[] PROGMEM = {
  0x00, 0x00, 0x00, 0x00, 0x00, 0x00, 0x00, 0x00, 0x00, 0x00, 0x00, 0x00, 0x00, 0x00, 0x00, 0x00,
  0x00, 0x00, 0x00, 0x00, 0x00, 0x00, 0x00, 0x00, 0x00, 0x00, 0x00, 0x00, 0x00, 0x00, 0x00, 0x00,
  0x00, 0x00, 0x00, 0x00, 0x00, 0x00, 0x00, 0x00, 0x00, 0x00, 0x00, 0x00, 0x00, 0x00, 0x00, 0x00,
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  0x00, 0x00, 0x00, 0x00, 0x00, 0x00, 0x00, 0x00, 0x00, 0x00, 0x00, 0x00, 0x00, 0x00, 0x00, 0x00
};

/////////////////////////////////////////////////////////////////////////////////////////////////////////////////////////////////////////
// real code starts here
/////////////////////////////////////////////////////////////////////////////////////////////////////////////////////////////////////////




// you know the drill
Adafruit_ST7735 Display = Adafruit_ST7735(TFT_CS, TFT_DC, TFT_RST);

// required, you must create either an Item menu (no inline editing) or an EditMenu (allows inline editing)
//ClassName YourMenuName(&DisplayObject, True=Touch input, False(Default)=mechanical input);
ItemMenu MainMenu(&Display);

// since we're showing both menu types, create an object for each where the item menu is the main and calls edit menus
// you can have an item menu call other item menus an edit menu can call an edit menu but in a round about way--not recommended
//ClassName YourMenuName(&DisplayObject, True=Touch input, False(Default)=mechanical input);
EditMenu OptionMenu(&Display);        // default is false, need not specify
EditMenu ColorMenu(&Display);  // or you can still call false to force mechanical input selection
EditMenu WirelessMenu(&Display);

ESP32Encoder encoder;

void setup() {

  Serial.begin(9600);

  // disableCore0WDT();


  ESP32Encoder::useInternalWeakPullResistors = UP;

  encoder.attachHalfQuad(EN1_PIN, EN2_PIN);
  encoder.clearCount();

  // button in the encoder
  pinMode(SE_PIN, INPUT_PULLUP);
  pinMode(LED_PIN, OUTPUT);
  pinMode(22, OUTPUT);



  // I use a digital pin to control LED brightness

  delay(10);
  digitalWrite(LED_PIN, HIGH);

 digitalWrite(22, LOW);
 

  // fire up the display
  Display.initR(INITR_GREENTAB);
  Display.setRotation(1);
/*
  while (1) {

    Serial.println("Encoder count = " + String((int32_t)encoder.getCount()));
    if (digitalRead(SE_PIN) == LOW) {
      Serial.println("button press");
    }
    delay(100);
  }
*/


  MainMenu.init(MENU_TEXT, MENU_BACKGROUND, MENU_HIGHLIGHTTEXT, MENU_HIGHLIGHT, 40, 2, "Main Menu", FONT_TITLE, FONT_TITLE);


  // now add each item, text is what's displayed for each menu item, there are no other arguements
  // there are 3 add types
  // 1. addNI for no icon
  // 2. addMono for simple 1 color  icon each item
  // 3. add565 for displaying a color icon for each item

  // note the return value for each item will be it's returned itemid an dwill be > 0
  // a return of 0 is reserved for the exit item
  // the exit item is actually the title bar--if user moves selector to the title bar
  // it's temporarily renamed to "Exit"

  /*
    addNI(ItemLabel);
    addMono(ItemLabel, MonoBitmap, BitmapWidth, BitmapHeight );
    add565(ItemLabel, ColorBitmap, uint8_t BitmapWidth, uint8_t BitmapHeight);
  */
  MenuOption1 = MainMenu.add565("Options", epd_bitmap_Temp2, 32, 32);
  MenuOption2 = MainMenu.add565("Colors", epd_bitmap_Alarm, 32, 32);
  MenuOption3 = MainMenu.add565("Wireless", epd_bitmap_Update, 32, 32);
  MenuOption4 = MainMenu.add565("Servos", epd_bitmap_Precision, 32, 32);

  // optional, but you can change title bar colors
  // setTitleColors(TitleTextColor, TitleFillColor);
  MainMenu.setTitleColors(TITLE_TEXT, TITLE_BACK);

  // these are all optional, but you can change title bar colors, size, and margins.
  // setTitleBarSize(TitleTop, TitleLeft, TitleWith, TitleHeight);
  MainMenu.setTitleBarSize(0, 0, 160, 30);

  // optional but lets center the title text about the height but scoot it in a bit from the left
  // setTitleTextMargins(LeftMargin, TopMargin);
  MainMenu.setTitleTextMargins(10, 20);

  // optional but you can set the left margin and top to scoot the icon over and down
  // only needed if you are using icons in your menu items
  // setIconMargins(LeftMargin, TopMargin);
  MainMenu.setIconMargins(0, 0);

  // optional but you can set the left margin and top to scoot the menu highLt over and down
  // not needed but recommended so you can better control where the text is placed
  // the library will not determine font height and such and adjust--that will be on you
  // setMenuBarMargins(LeftMargin, Width, BorderRadius, BorderThickness);
  MainMenu.setMenuBarMargins(0, 160, 0, 4);

  // optional but you can set the menu highLt special colors (disable text color and border color)
  // not needed if you dont plan on disabling menu items
  // the library will not determine font height and such and adjust--that will be on you
  // setItemColors(DisableTextColor, BorderColor);
  MainMenu.setItemColors(MENU_DISABLE, MENU_HIGHBORDER);

  // setItemTextMargins(LeftMargin, TopMargin, MarginBetweenTitleBarAndMenu);
  MainMenu.setItemTextMargins(10, 20, 5);

  // end of ItemMenu setup




  // this example includes both menu types, the first (above was a menu where items have not editing)
  // this menu type EditMenu allows changes for each items value--basically in-line editing
  // more capability? more arguements...

  /*
     init(TextColor, BackgroundColor, HighLtTextColor, HighLtColor, SelectedTextColor, SelectedColor,
      MenuColumn, ItemRowHeight,MaxRowsPerScreen, TitleText, ItemFont, TitleFont);
  */
  OptionMenu.init(MENU_TEXT, MENU_BACKGROUND, MENU_HIGHLIGHTTEXT, MENU_HIGHLIGHT, MENU_SELECTTEXT, MENU_SELECT,
                  DATA_COLUMN, 40, 2, "Option Menu", FONT_ITEM, FONT_TITLE);

  // now add each item, text is what's displayed for each menu item, there are no other arguements
  // there are 3 add types
  // 1. addNI for no icon
  // 2. addMono for simple 1 color  icon each item
  // 3. add565 for displaying a color icon for each item

  // note the return value for each item will be it's returned itemid an dwill be > 0
  // a return of 0 is reserved for the exit item
  // the exit item is actually the title bar--if user moves selector to the title bar
  // it's temporarily renamed to "Exit" while the selector is on the menu bar

  // the edit can be either by cycling through a range of values (low to high by some increment value
  // example, set a voltage divider calibration value 4000 to 10000 in increments of 100
  // or cycle through an array list
  // example, choose your favorite pet from a list ("cat", "dog", "bird", "fish")
  // you still enter a lower and high limit and are the array bounds (0 to 3 in the above example)
  // your Data is the initial array value so you can still have say "bird" be the initial value)
  // in either case you can have icons none, mono or color
  // the example below for OptionOption1, notice the menu value is a variable (AllowColorMenu)
  // this allows you to make sure the menu matches actual current settings. Idea: store settings in the eeprom
  // read at startup, populate the menu items, upon menu completion, store the value back in the eeprom

  /*
    addNI(ItemText, InitalDisplayData, LowLimit, HighLimit, IncrementValue, DisplayDecimalPlaces, ItemMenuText);

    addMono(ItemText, Data, LowLimit, HighLimit, Increment, DecimalPlaces, ItemMenuText,
    Bitmap, BitmapWidth, BitmapHeight);

    add565(ItemText, Data, LowLimit, HighLimit, Increment, DecimalPlaces, ItemMenuText,
    Bitmap, BitmapWidth, BitmapHeight);
  */
  OptionOption1 = OptionMenu.add565("Colors", AllowColorMenu, 0, sizeof(OffOnItems) / sizeof(OffOnItems[0]), 1, 0, OffOnItems, epd_bitmap_Temp1, 32, 32);
  OptionOption2 = OptionMenu.add565("Temp.", Temp2Adj, -1.0, 1.0, .05, 2, NULL, epd_bitmap_Temp2, 32, 32);
  OptionOption3 = OptionMenu.add565("Read", 2, 0, sizeof(ReadoutItems) / sizeof(ReadoutItems[0]), 1, 0, ReadoutItems, epd_bitmap_readout, 32, 32);
  OptionOption4 = OptionMenu.add565("Tune", 0, 0, 20, 1, 0, NULL, epd_bitmap_Tune, 32, 32);
  OptionOption5 = OptionMenu.add565("Alarm", AlarmVal, 0, sizeof(OffOnItems) / sizeof(OffOnItems[0]), 1, 0, OffOnItems, epd_bitmap_Alarm, 32, 32);
  OptionOption6 = OptionMenu.add565("Prec", 0, 0, sizeof(PrecisionItems) / sizeof(PrecisionItems[0]), 1, 0, PrecisionItems, epd_bitmap_Precision, 32, 32);

  // again all these calls are optional, but you most likely will want to set margins

  // optional but you can store a setting such as a calibration value in EEPROM, read at startup
  // and populate with SetItemValue(), even though the item data was set in the add method, you can change it later
  // SetItemValue(ItemID, ItemValue){
  OptionMenu.SetItemValue(OptionOption1, 0.12);
  OptionMenu.SetItemValue(OptionOption3, 1);  // the 2nd element in the ReadoutItems array

  // optional but can can set the title colors
  // setTitleColors(TitleTextColor, TitleFillColor);
  OptionMenu.setTitleColors(TITLE_TEXT, TITLE_BACK);

  // optional but you can set the size of the title bar
  // setTitleBarSize(TitleTop, TitleLeft, TitleWith, TitleHeight);
  OptionMenu.setTitleBarSize(0, 0, 160, 25);

  // optional but you can set the margins in how the text in the title bar is centered
  // setTitleTextMargins(LeftMargin, TopMargin);
  OptionMenu.setTitleTextMargins(10, 10);

  // optional but you can scoot the icon over and down
  // setIconMargins(LeftMargin, TopMargin);
  OptionMenu.setIconMargins(5, 0);

  // optional but you can set the margins and size of the text in the menu bar
  // setItemTextMargins(LeftMargin, TopMargin, MarginBetweenTitleBarAndMenu);
  OptionMenu.setItemTextMargins(7, 25, 5);

  OptionMenu.setMenuBarMargins(0, 160, 0, 4);

  // optional but you can change colors other that in the init method
  // colors such as disable text and border color (if you display a border of course)
  // setItemColors(DisableTextColor, HighLt, EditSelectBorderColor);
  OptionMenu.setItemColors(MENU_DISABLE, MENU_HIGHBORDER, MENU_SELECTBORDER);

  // i'm now just going to rip through creating the color menu, again take note or arg 2--it's the initial menu item value
  // since colors are in arrays we can't simply put MENU_TEXT for the first add method--MENU_TEXT is the corresponding hex value
  // gotta put it's index, the library knows you are using array and will take the passed index and show the correct text
  // remember...
  // C_NAMES[1] = "White"
  // C_VALUES[1] = {  0XFFFF,
  // MENU_TEXT = C_VALUES[1]; // white

  ColorMenu.init(MENU_TEXT, MENU_BACKGROUND, MENU_HIGHLIGHTTEXT, MENU_HIGHLIGHT, MENU_SELECTTEXT, MENU_SELECT,
                 DATA_COLUMN-10, 22, 4, "Color Menu", FONT_ITEM, FONT_TITLE);

  ColorOption1 = ColorMenu.addNI("Menu", 1, 0, sizeof(C_NAMES) / sizeof(C_NAMES[0]), 1, 0, C_NAMES);
  ColorOption2 = ColorMenu.addNI("Back", 0, 0, sizeof(C_NAMES) / sizeof(C_NAMES[0]), 1, 0, C_NAMES);
  ColorOption3 = ColorMenu.addNI("Select", 1, 0, sizeof(C_NAMES) / sizeof(C_NAMES[0]), 1, 0, C_NAMES);
  ColorOption4 = ColorMenu.addNI("Bar", 21, 0, sizeof(C_NAMES) / sizeof(C_NAMES[0]), 1, 0, C_NAMES);
  ColorOption5 = ColorMenu.addNI("Border", 10, 0, sizeof(C_NAMES) / sizeof(C_NAMES[0]), 1, 0, C_NAMES);
  ColorOption6 = ColorMenu.addNI("Text", 0, 0, sizeof(C_NAMES) / sizeof(C_NAMES[0]), 1, 0, C_NAMES);
  ColorOption7 = ColorMenu.addNI("Bar", 4, 0, sizeof(C_NAMES) / sizeof(C_NAMES[0]), 1, 0, C_NAMES);
  ColorOption8 = ColorMenu.addNI("Border", 37, 0, sizeof(C_NAMES) / sizeof(C_NAMES[0]), 1, 0, C_NAMES);
  ColorOption9 = ColorMenu.addNI("Disable", 2, 0, sizeof(C_NAMES) / sizeof(C_NAMES[0]), 1, 0, C_NAMES);
  ColorOption10 = ColorMenu.addNI("Text", 13, 0, sizeof(C_NAMES) / sizeof(C_NAMES[0]), 1, 0, C_NAMES);
  ColorOption11 = ColorMenu.addNI("Fill", 36, 0.0, sizeof(C_NAMES) / sizeof(C_NAMES[0]), 1, 0, C_NAMES);

  // all these are optional, but you will most likely need to set the margins, the library will not look at text height and
  // row height and attempt to center
  ColorMenu.setTitleBarSize(0, 0, 160, 25);
  ColorMenu.setTitleTextMargins(10, 20);
  ColorMenu.setItemTextMargins(0, 15, 1);
  ColorMenu.setMenuBarMargins(2, 156, 4, 2);

  // optional but showing how you can have several small items and not large pretty icons
  WirelessMenu.init(MENU_TEXT, MENU_BACKGROUND, MENU_HIGHLIGHTTEXT, MENU_HIGHLIGHT, MENU_SELECTTEXT, MENU_SELECT,
                    DATA_COLUMN, 22, 4, "Wireless Menu", FONT_SMALL, FONT_ITEM);
  WirelessOption1 = WirelessMenu.addNI("Channel", 0, 0, 63, 1, 0);
  WirelessOption2 = WirelessMenu.addNI("Address", 0, 0, 255, 1, 0);
  WirelessOption3 = WirelessMenu.addNI("Data", 2, 0, sizeof(DataRateItems) / sizeof(DataRateItems[0]), 1, 0, DataRateItems);
  WirelessOption4 = WirelessMenu.addNI("Air", 2, 0, sizeof(DataRateItems) / sizeof(DataRateItems[0]), 1, 0, DataRateItems);
  WirelessOption5 = WirelessMenu.addNI("Error", 1, 0, sizeof(OffOnItems) / sizeof(OffOnItems[0]), 1, 0, OffOnItems);
  WirelessOption6 = WirelessMenu.addNI("Power", 0, 0, 100, 10, 0);
  WirelessOption7 = WirelessMenu.addNI("FEC", 0, 0, 100, 10, 0);

  WirelessMenu.setTitleBarSize(0, 0, 160, 30);
  WirelessMenu.setTitleTextMargins(10, 20);
  WirelessMenu.setItemTextMargins(0, 15, 1);
  WirelessMenu.setMenuBarMargins(2, 156, 2, 2);

  // I'm so not a fan on my API for setting select border color... this arguement should have been in the menubar thingy...
  // code is implemented in probably millions of projects around the world so no sense breaking them :)

  WirelessMenu.setItemColors(MENU_DISABLE, MENU_HIGHBORDER, MENU_SELECTBORDER);

  WirelessMenu.setTitleColors(TITLE_TEXT, TITLE_BACK);

  // optional but you can set the speed in which press and hold the up / down arrows increments the values
  // default is 50ms and while snappy, can be hard to stop on the desired value
  WirelessMenu.setIncrementDelay(150);


  // you can simplay call the draw method on a menu object, but you will need to add processing
  // here's how I recommend doing that, have a function that draws the main menu and processes the selections
  // ideally you will probably have a "setting" button in your UI that will call the "ProcessMainMenu"

  // you can simplay call the draw method on a menu object, but you will need to add processing
  // here's how I recommend doing that, have a function that draws the main menu and processes the selections
  // ideally you will probably have a "setting" button in your UI that will call the "ProcessMainMenu"

  ProcessMainMenu();

  // menu code done, now proceed to your code
  Display.fillScreen(MENU_BACKGROUND);
}

void loop() {

  // this is just a processor for when you exit the top level menu
  Display.setCursor(10, 100);
  Display.setFont(&FONT_TITLE);
  Display.setTextColor(MENU_HIGHLIGHT, MENU_SELECTTEXT);
  Display.print(F("Done"));
  delay(500);
  Display.setCursor(10, 100);
  Display.setFont(&FONT_TITLE);
  Display.setTextColor(MENU_HIGHLIGHT, MENU_SELECTTEXT);
  Display.print(F("Done"));
  delay(500);

  // and example on how you can call menu while in a loop
  // of course you will probably have a button to launch ProcessMainMenu
  if (Serial.available()) {
    if (Serial.read() >= 32) {
      ProcessMainMenu();
      Display.fillScreen(MENU_BACKGROUND);
    }
  }
}

// function to process main menu iteraction
// ideally this implementation makes it easy to launch your menu from anywhere in th
void ProcessMainMenu() {

  // set an inital flag that will be used to store what menu item the user exited on
  int MainMenuOption = 1;

  // blank out the screen
  Display.fillScreen(MENU_BACKGROUND);

  // draw the main menu
  MainMenu.draw();

  // run the processing loop until user move selector to title bar (which becomes exit, i.e. 0 return val)
  // and selectes it
  // note menu code can return - 1 for errors so run unitl non zero

  while (MainMenuOption != 0) {

    // standard encoder read
    Position = encoder.getCount();

    // attempt to debouce these darn things...
    if ((Position - oldPosition) > 0) {
      delay(DEBOUNCE);
      while (oldPosition != Position) {
        oldPosition = Position;
        Position = encoder.getCount();
      }

      // once encoder calms down and is done cycling, move selector up
      // since encoder reads are increasing
      // any menu wrapping is handled in the library
      MainMenu.MoveUp();
    }
    // attempt to debouce these darn things...
    if ((Position - oldPosition) < 0) {
      delay(DEBOUNCE);
      while (oldPosition != Position) {
        oldPosition = Position;
        Position = encoder.getCount();
      }
      // once encoder calms down and is done cycling, move selector up
      // since encoder reads are decreasing
      // any menu wrapping is handled in the library
      MainMenu.MoveDown();
    }

    // but wait...the user pressed the button on the encoder
    if (digitalRead(SE_PIN) == LOW) {

      // debounce the button press
      while (digitalRead(SE_PIN) == LOW) {
        delay(DEBOUNCE);
      }

      // get the row the selector is on
      MainMenuOption = MainMenu.selectRow();

      // here is where you process accordingly
      // remember on pressing button on title bar 0 is returned and will exit the loop

      if (MainMenuOption == MenuOption1) {
        // item 1 was the Option menu
        ProcessOptionMenu();
        // when done processing that menu, return here
        // clear display and redraw this main menu
        Display.fillScreen(MENU_BACKGROUND);
        MainMenu.draw();
      }
      if (MainMenuOption == MenuOption2) {
        ProcessColorMenu();
        Display.fillScreen(MENU_BACKGROUND);
        MainMenu.draw();
      }
      if (MainMenuOption == MenuOption3) {
        ProcessWirelessMenu();
        Display.fillScreen(MENU_BACKGROUND);
        MainMenu.draw();
      }

      if (MainMenuOption == MenuOption4) {
        //ImTooLazyToWriteAnotherExampe();
        Display.fillScreen(MENU_BACKGROUND);
        MainMenu.draw();
      }
    }
  }

  // at this point MenuOption better be 0...
}

// menu to handle processing for a sub-menu
// since this menu will be a menu that allows edits (EditMenu object type)
// process is exactly the same as an ItemMenu
// meaning you simply use the same MoveUp, MoveDown and the library will know if you are
// wanting to move the selector or cycle through a range

void ProcessOptionMenu() {

  // the entire menu processing are basically 3 calls
  // YourMenu.MoveUp();
  // YourMenu.MoveDown();
  // EditMenuOption = YourMenu.selectRow();

  // set an inital flag that will be used to store what menu item the user exited on
  int EditMenuOption = 1;

  // blank out the screen
  Display.fillScreen(MENU_BACKGROUND);

  // draw the main menu
  OptionMenu.draw();

  // run the processing loop until user move selector to title bar (which becomes exit)
  // and selectes it
  while (EditMenuOption != 0) {

    // standard encoder read
    Position = encoder.getCount();

    // attempt to debouce these darn things...
    if ((Position - oldPosition) > 0) {
      delay(DEBOUNCE);
      while (oldPosition != Position) {
        oldPosition = Position;
        Position = encoder.getCount();
      }
      // once encoder calms down and is done cycling, move selector up
      // since encoder reads are increasing
      // any menu wrapping is handled in the library

      // the EditMenu object type is special cased
      // 1. if a row was NOT selected, MoveUp / MoveDown will cycle throuh menu items
      // 2. if a row IS selected, MoveUp / MoveDown will cycle throuh the range of values withing the item

      OptionMenu.MoveUp();
    }

    if ((Position - oldPosition) < 0) {
      delay(DEBOUNCE);
      while (oldPosition != Position) {
        oldPosition = Position;
        Position = encoder.getCount();
      }
      // once encoder calms down and is done cycling, move selector up
      // since encoder reads are decreasing
      // any menu wrapping is handled in the library

      // the EditMenu object type is special cased
      // 1. if a row was NOT selected, MoveUp / MoveDown will cycle throuh menu items
      // 2. if a row IS selected, MoveUp / MoveDown will cycle throuh the range of values withing the item
      OptionMenu.MoveDown();
    }

    if (digitalRead(SE_PIN) == LOW) {

      // debounce the selector button
      while (digitalRead(SE_PIN) == LOW) {
        delay(DEBOUNCE);
      }
      // use the selectRow to
      // 1. select a row for editing
      // a. when a row is selected, moveup, movedown will then scroll through the editable values (values or a list)
      // 2. unselect a row when editing is done
      // 3. when selector is on the title bar annd selecRow is called a 0 is returned

      EditMenuOption = OptionMenu.selectRow();


      // this next section is purely optional and shows how data change can be used
      // the EditMenu object type is special cased where if you select a menu item
      // the library consideres that a desire to start editing the item
      // the menu bar color changes and any MoveUp / MoveDown will then be directed
      // to editing the item value itself
      // once user Selects the selected row, the library will consider editign done
      // and restore menu selection with MoveUp / MoveDown
      // watch the YouTube video for a demo
      // to modify other values
      if (EditMenuOption == OptionOption5) {  // budget item
        if (OptionMenu.value[OptionOption5] == 0) {
          OptionMenu.disable(OptionOption4);
          OptionMenu.setItemText(OptionOption4, "Tune (Alarm OFF)");
          OptionMenu.drawRow(OptionOption4);
        } else {
          OptionMenu.enable(OptionOption4);
          OptionMenu.setItemText(OptionOption4, "Tune");
          OptionMenu.drawRow(OptionOption4);
        }
      }
    }
  }

  // user must have pressed the encorder select button while on the title bar (which returns 0)
  // hence exiting the loop
  // now you can process / store / display the menu selections
  // remember this is from the EditMenu and has associated value property with each menu item
  Serial.println("Option Menu Selections ");
  Serial.println("______________________________");
  Serial.print("Color Adj ");
  Serial.println(OptionMenu.value[OptionOption1]);
  Serial.print("Temp2 Adj ");
  Serial.println(OptionMenu.value[OptionOption2]);
  Serial.print("Readout ");
  Serial.println(ReadoutItems[(int)OptionMenu.value[OptionOption3]]);
  Serial.print("Tune ");
  Serial.println(TuneItems[(int)OptionMenu.value[OptionOption4]]);
  Serial.print("Alarm ");
  Serial.println(OffOnItems[(int)OptionMenu.value[OptionOption5]]);
  Serial.print("Precision ");
  Serial.println(PrecisionItems[(int)OptionMenu.value[OptionOption6]]);

}

void ProcessColorMenu() {

  // the entire menu processing are basically 3 calls
  // YourMenu.MoveUp();
  // YourMenu.MoveDown();
  // EditMenuOption = YourMenu.selectRow();


  // set an inital flag that will be used to store what menu item the user exited on
  int EditMenuOption = 1;

  // blank out the screen
  Display.fillScreen(MENU_BACKGROUND);

  // draw the main menu
  ColorMenu.draw();

  // run the processing loop until user move selector to title bar (which becomes exit)
  // and selectes it
  while (EditMenuOption != 0) {

    delay(50);
    Position = encoder.getCount();
    if ((Position - oldPosition) > 0) {
      delay(DEBOUNCE);
      while (oldPosition != Position) {
        oldPosition = Position;
        Position = encoder.getCount();
      }
      ColorMenu.MoveUp();
    }

    if ((Position - oldPosition) < 0) {
      delay(DEBOUNCE);
      while (oldPosition != Position) {
        oldPosition = Position;
        Position = encoder.getCount();
      }
      ColorMenu.MoveDown();
    }

    if (digitalRead(SE_PIN) == LOW) {

      // debounce the selector button
      while (digitalRead(SE_PIN) == LOW) {
        delay(DEBOUNCE);
      }

      EditMenuOption = ColorMenu.selectRow();
    }
  }

  // out of menu now time for processing

  // set global back color
  Serial.print("back color");

  Serial.println(C_VALUES[(int)ColorMenu.value[ColorOption2]]);


  MENU_BACKGROUND = C_VALUES[(int)ColorMenu.value[ColorOption2]];

  // set Option menu colors

  MainMenu.SetAllColors(C_VALUES[(int)ColorMenu.value[ColorOption1]],
                        C_VALUES[(int)ColorMenu.value[ColorOption2]],
                        C_VALUES[(int)ColorMenu.value[ColorOption3]],
                        C_VALUES[(int)ColorMenu.value[ColorOption4]],
                        C_VALUES[(int)ColorMenu.value[ColorOption8]],
                        C_VALUES[(int)ColorMenu.value[ColorOption9]],
                        C_VALUES[(int)ColorMenu.value[ColorOption10]],
                        C_VALUES[(int)ColorMenu.value[ColorOption11]]);

  OptionMenu.SetAllColors(C_VALUES[(int)ColorMenu.value[ColorOption1]],
                          C_VALUES[(int)ColorMenu.value[ColorOption2]],
                          C_VALUES[(int)ColorMenu.value[ColorOption3]],
                          C_VALUES[(int)ColorMenu.value[ColorOption4]],
                          C_VALUES[(int)ColorMenu.value[ColorOption5]],
                          C_VALUES[(int)ColorMenu.value[ColorOption6]],
                          C_VALUES[(int)ColorMenu.value[ColorOption7]],
                          C_VALUES[(int)ColorMenu.value[ColorOption8]],
                          C_VALUES[(int)ColorMenu.value[ColorOption9]],
                          C_VALUES[(int)ColorMenu.value[ColorOption10]],
                          C_VALUES[(int)ColorMenu.value[ColorOption11]]);
  // set color menu colors
  ColorMenu.SetAllColors(C_VALUES[(int)ColorMenu.value[ColorOption1]],
                         C_VALUES[(int)ColorMenu.value[ColorOption2]],
                         C_VALUES[(int)ColorMenu.value[ColorOption3]],
                         C_VALUES[(int)ColorMenu.value[ColorOption4]],
                         C_VALUES[(int)ColorMenu.value[ColorOption5]],
                         C_VALUES[(int)ColorMenu.value[ColorOption6]],
                         C_VALUES[(int)ColorMenu.value[ColorOption7]],
                         C_VALUES[(int)ColorMenu.value[ColorOption8]],
                         C_VALUES[(int)ColorMenu.value[ColorOption9]],
                         C_VALUES[(int)ColorMenu.value[ColorOption10]],
                         C_VALUES[(int)ColorMenu.value[ColorOption11]]);
  // set color menu colors
  WirelessMenu.SetAllColors(C_VALUES[(int)ColorMenu.value[ColorOption1]],
                            C_VALUES[(int)ColorMenu.value[ColorOption2]],
                            C_VALUES[(int)ColorMenu.value[ColorOption3]],
                            C_VALUES[(int)ColorMenu.value[ColorOption4]],
                            C_VALUES[(int)ColorMenu.value[ColorOption5]],
                            C_VALUES[(int)ColorMenu.value[ColorOption6]],
                            C_VALUES[(int)ColorMenu.value[ColorOption7]],
                            C_VALUES[(int)ColorMenu.value[ColorOption8]],
                            C_VALUES[(int)ColorMenu.value[ColorOption9]],
                            C_VALUES[(int)ColorMenu.value[ColorOption10]],
                            C_VALUES[(int)ColorMenu.value[ColorOption11]]);
}

void ProcessWirelessMenu() {

  int EditMenuOption = 1;

  Display.fillScreen(MENU_BACKGROUND);

  WirelessMenu.draw();

  while (EditMenuOption != 0) {
    delay(50);
    Position = encoder.getCount();
    if ((Position - oldPosition) > 0) {
      oldPosition = Position;
      WirelessMenu.MoveUp();
    }

    if ((Position - oldPosition) < 0) {
      oldPosition = Position;
      WirelessMenu.MoveDown();
    }

    if (digitalRead(SE_PIN) == LOW) {

      // debounce the selector button
      while (digitalRead(SE_PIN) == LOW) {
        delay(DEBOUNCE);
      }

      EditMenuOption = WirelessMenu.selectRow();
    }
  }
}


///////////////////////////////////////////////////////////////////////////////////////////////////
// end of example
//////////////////////////////////////////////////////////////////////////////////////////////////
